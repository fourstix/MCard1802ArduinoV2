/*
 * Programs to load into 1802 Cosmac Elf
 */


int data_size = 0;

//Program 2 - The original Cosmac Elf spaceship program by Joseph Weisbecker
//  modified to run in any page and to toggle Q instead of over-writing code
//  when the input button is pressed.
const uint8_t spaceship[] PROGMEM = {
  // program code (upper 25% of the screen contains display code)
  0x90, 0xB1, 0xB2, 0xB3, 0xB4, 0xF8, 0x2D, 0xA3,
  0xF8, 0x3F, 0xA2, 0xF8, 0x11, 0xA1, 0xD3, 0x72,
  //0x0010
  //Patch to keep interrupt cycles and byte count same
  0x70, 0x22, 0x78, 0x22, 0x52, 0xC4, 0xE2, 0xE2,
  //Patch to set R0 to page image location
  0xE2, 0x91, 0xB0, 0xF8, 0x00, 0xA0, 0x80, 0xE2,
  //0x0020
  0xE2, 0x20, 0xA0, 0xE2, 0x20, 0xA0, 0xE2, 0x20,
  0xA0, 0x3C, 0x1E, 0x30, 0x0F, 0xE2, 0x69, 0x3F,
  //0x0030
  //Patch - Toggle Q instead of over-writing memory (ROM)
  0x2F, 0x37, 0x31, 0xCD, 0x7B, 0x38, 0x7A, 0x30,
  0x2F, 0x00, 0x00, 0x00, 0x00, 0x00, 0x00, 0x00,
  //0x0040
  // bitmap  (the bottom 75% of the screen is the bitmap)
  0x00,   0x00,   0x00,   0x00,   0x00,   0x00,   0x00,   0x00, 
  0x00,   0x00,   0x00,   0x00,   0x00,   0x00,   0x00,   0x00, 
  0x7B,   0xDE,   0xDB,   0xDE,   0x00,   0x00,   0x00,   0x00, 
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  0x00,   0x00,   0x07,   0xF0,   0x00,   0x00,   0x00,   0x00 
};

//Program 3 -- Tom Pittman's TV Digital clock program
const uint8_t tv_digital_clock[] PROGMEM = {
  0x90, 0xB1, 0xB2, 0xB3, 0xF8, 0x1B, 0xA1, 0xF8, 
  0xFF, 0xA2, 0xF8, 0x0F, 0xA3, 0x70, 0x23, 0x69,
  0x30, 0xAC, 0x12, 0x42, 0xF6, 0x42, 0xB7, 0x42,
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  0xBF, 0x6C, 0xFE, 0x30, 0xAC, 0xE2, 0xE2, 0x00
};

//Program 4 - Quick video DMA test, based on Tom Pittman's program
const uint8_t video_dma_test[] PROGMEM = {
  0x90, 0xB1, 0xB2, 0xB3, 0xF8, 0x1B, 0xA1, 0xF8,
  0xFF, 0xA2, 0xF8, 0x0F, 0xA3, 0x71, 0x23, 0x69,
  0xF8, 0x18, 0xA0, 0x30, 0x10, 0x00, 0x00, 0x00,
  //Replace these values with any pattern you prefer
  0x55, 0x55, 0x99, 0x99, 0XEE, 0xEE, 0x0F, 0x0F  
};

//Program 5 - EETops Monitor program
//
//  Extended ETOPS by Mike Riley
//
//  This program is an extension of the ETOPS program from Popular Electronics. 
//  This version allows for full 16-bit addresses.
//
//  This program is used by first placing the desired function code on the switches
//  and then placing the computer into run mode. At this point the computer will 
//  wait for the high portion of the address. Enter the high byte of the address on the
//  switches and then press the IN button. Then the computer will wait for the low byte
//  of the address. Again, enter this portion of the address on the switches and press
//  the IN button. Then the program will perform the requested function:
//
//    00 - Run program. The program will execute with R0
//    01 - Examine Memory. This function allows you to examine memory, while the IN button is
//         pressed, the data displays will show the next low address to be displayed. When the IN
//         button is released, the data byte will be displayed.
//    02 - Modify Memory. This function allows you to enter bytes into memory. Like the 01 function,
//         while the IN button is pressed, the low address of the next address to be written will be
//         displayed, when IN is released the toggles will be read and the value stored into memory.
//         In this mode the Q led will be lit to remind you that you are in modify mode.
const uint8_t eetops_monitor[] PROGMEM = {
  0x90, 0xB2, 0xF8, 0x3B, 0xA2, 0xE2, 0x90, 0xB3, 
  0xF8, 0x0C, 0xA3, 0xD3, 0x6C, 0x64, 0x22, 0xA1,
  0x3F, 0x10, 0x37, 0x12, 0x6C, 0x64, 0x22, 0xB0, 
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  0x22, 0x30, 0x29, 0x00, 0x00, 0x00, 0x00, 0x00
};


//Program 6 - Game of Life program
//  
//    Conway's Game of Life
//
//  http://www.radicaleye.com/lifepage/
//  http://www.math.com/students/wonders/life/life.html
//
//Implemented on Cosmac Elf by Josh Bensadon,  Sept 2003
//
//This is a simulation game.  The entire screen is a 2 dimensional
//world for these cells.  Each cell has 8 neighbors (above, below,
//right, left, and 4 diagonal corners).  If a cell is alive and
//has exactly 2 or 3 neighbors, it remains alive.  If less than 2,
//it dies of loniness, more than 3 it's over crowded.  If a cell
//is not alive, and there are exactly 3 neighbors, it will come
//alive in the next cycle.
//
//Load the game at 0x0000,  it uses 3 pages.
//It requires pages 6 and 7 for video (it fills the alternate page).
//Hence, program requires 2K of ram.
//
//Turn Data switch 7 ON (Input mode) [Enter 80 on Hex keypad]
// 
//Turn Run switch ON
// 
//Input Mode:
//   Switch 6 does a Clear Screen.  [Enter C0 on Hex Keypad]
//   Switch 0 moves cursor right    [Enter 81 on Hex Keypad]
//   Switch 1  "      "    left     [Enter 82 on Hex Keypad]  
//   Switch 2  "      "    down     [Enter 84 on Hex Keypad]
//   Switch 3  "      "    up       [Enter 88 on Hex Keypad]
//   Input Switch toggles the pixel (cell).  Holding this switch down
//   will set/reset many cells if the cursor is moving in any direction.
//
//   Set your pattern, or use the random pattern that was in the undefined
//   RAM space.
//
//   Turn Switch 7 OFF  (Run Mode)
//    [Enter 00 on Hex Keypad]
//Run Mode:
//Hex display shows the current generation (00-FF, then loops)
//Sit back and watch the game of life!
//
//Turn Switch 7 ON at any time to return to Input Mode
//
//
//Enjoy!
const uint8_t game_of_life[] PROGMEM = {
  //Address: 0x0000 (Page 0)
  0x90, 0xB1, 0xB2, 0xB3, 0xAB, 0xF8, 0x02, 0xBA, 0xB4, 0xF8, 0x09, 0xA4, 0xF8, 0x19, 0xA1, 0xF8,
  0x3D, 0xA2, 0xF8, 0x3E, 0xA3, 0xE2, 0xD3, 0x72, 0x70, 0x22, 0x78, 0x22, 0x52, 0xC4, 0xF8, 0x00,
  0xA0, 0x9B, 0xB0, 0xE2, 0xE2, 0xE2, 0x80, 0xE2, 0xE2, 0x20, 0xA0, 0xE2, 0x20, 0xA0, 0xE2, 0x20,
  0xA0, 0x3C, 0x26, 0x30, 0x17, 0x00, 0x00, 0x00, 0x00, 0x00, 0x00, 0x00, 0x00, 0x00, 0x69, 0xF8,
  //Address: 0x0040
  0x07, 0xBB, 0x6C, 0xFA, 0x80, 0x3A, 0x4A, 0xC0, 0x01, 0x00, 0x6C, 0xFA, 0x40, 0x32, 0x61, 0x93,
  0xAB, 0x93, 0x5B, 0x1B, 0x8B, 0x3A, 0x51, 0x2B, 0xAB, 0xAC, 0x6C, 0xFA, 0x7F, 0x3A, 0x5A, 0x30,
  0x42, 0xEB, 0x8C, 0xFA, 0x07, 0xAA, 0x0A, 0xF3, 0x00, 0x00, 0x5B, 0x0A, 0xF3, 0x00, 0x00, 0x5B,
  0x3F, 0x88, 0x9C, 0x3A, 0x7E, 0x0A, 0xF2, 0x32, 0x7B, 0xF8, 0x01, 0xF9, 0x02, 0xBC, 0xF6, 0x0A,
  //Address: 0x0080  
  0x3B, 0x86, 0xFB, 0xFF, 0xF2, 0x38, 0xF1, 0x5B, 0xE2, 0x6C, 0xFA, 0x01, 0x3A, 0xB6, 0x6C, 0xFA,
  0x02, 0x3A, 0xA9, 0x6C, 0xFA, 0x04, 0x3A, 0xA4, 0x6C, 0xFA, 0x08, 0x3A, 0x9F, 0x30, 0xC2, 0x8B,
  0xFF, 0x08, 0x30, 0xC1, 0x8B, 0xFC, 0x08, 0x30, 0xC1, 0x8C, 0xFC, 0xFF, 0xFA, 0x07, 0xAC, 0x33,
  0xC2, 0x8B, 0xFF, 0x01, 0x30, 0xC1, 0x8C, 0xFC, 0x01, 0xFA, 0x07, 0xAC, 0x3A, 0xC2, 0x8B, 0xFC,
  //Address: 0x00C0
  0x01, 0xAB, 0x00, 0x00, 0x00, 0x37, 0x42, 0xF8, 0x00, 0xBC, 0x30, 0x42, 0x00, 0x00, 0x00, 0x00,
  0x00, 0x00, 0x00, 0x00, 0x00, 0x00, 0x00, 0x00, 0x00, 0x00, 0x00, 0x00, 0x00, 0x00, 0x00, 0x00,
  0x00, 0x00, 0x00, 0x00, 0x00, 0x00, 0x00, 0x00, 0x00, 0x00, 0x00, 0x00, 0x00, 0x00, 0x00, 0x00,
  0x00, 0x00, 0x00, 0x00, 0x00, 0x00, 0x00, 0x00, 0x00, 0x00, 0x00, 0x00, 0x00, 0x00, 0x00, 0x00,
  //Address: 0x0100 (Page 1)
  0xBF, 0xE2, 0x9B, 0xFB, 0x01, 0xB5, 0xF8, 0x00, 0xA5, 0x85, 0xAB, 0xF8, 0x00, 0xA8, 0xAE, 0xAF,
  0x0B, 0xA6, 0x8B, 0xFC, 0x08, 0xAB, 0x0B, 0xB7, 0x8B, 0xFF, 0x10, 0xAB, 0x0B, 0xA7, 0x8B, 0xFA,
  0xF8, 0x52, 0x8B, 0xFC, 0x01, 0xFA, 0x07, 0xF1, 0xAB, 0x0B, 0xFE, 0x3B, 0x2E, 0x18, 0x8B, 0xFC,
  0x08, 0xAB, 0x0B, 0xFE, 0x3B, 0x37, 0x18, 0x8B, 0xFC, 0x08, 0xAB, 0x0B, 0xFE, 0x3B, 0x40, 0x18,
  //Address: 0x0140
  0x8B, 0xFF, 0x10, 0xFA, 0xF8, 0x52, 0x8B, 0xFF, 0x02, 0xFA, 0x07, 0xF1, 0xAB, 0x0B, 0xF6, 0x3B,
  0x52, 0x1F, 0x8B, 0xFC, 0x08, 0xAB, 0x0B, 0xF6, 0x3B, 0x5B, 0x1F, 0x8B, 0xFC, 0x08, 0xAB, 0x0B,
  0xF6, 0x3B, 0x64, 0x1F, 0x8E, 0xA9, 0xAA, 0xAB, 0xAC, 0xAD, 0x87, 0xF6, 0x3B, 0x70, 0x18, 0x19,
  0xF6, 0x3B, 0x76, 0x18, 0x19, 0x1A, 0xF6, 0x3B, 0x7C, 0x19, 0x1A, 0x1B, 0xF6, 0x3B, 0x82, 0x1A,
  //Address: 0x0180
  0x1B, 0x1C, 0xF6, 0x3B, 0x88, 0x1B, 0x1C, 0x1D, 0xF6, 0x3B, 0x8E, 0x1C, 0x1D, 0x1E, 0xF6, 0x3B,
  0x94, 0x1D, 0x1E, 0x1F, 0x32, 0x98, 0x1E, 0x1F, 0xD4, 0x85, 0xFC, 0x01, 0xA5, 0x3A, 0x09, 0x95,
  0xBB, 0x9F, 0xFC, 0x01, 0xBF, 0x52, 0x64, 0x22, 0x6C, 0xFA, 0x80, 0x32, 0x01, 0xC0, 0x00, 0x42,
  0x00, 0x00, 0x00, 0x00, 0x00, 0x00, 0x00, 0x00, 0x00, 0x00, 0x00, 0x00, 0x00, 0x00, 0x00, 0x00,
  //Address: 0x01C0
  0x00, 0x00, 0x00, 0x00, 0x00, 0x00, 0x00, 0x00, 0x00, 0x00, 0x00, 0x00, 0x00, 0x00, 0x00, 0x00,
  0x00, 0x00, 0x00, 0x00, 0x00, 0x00, 0x00, 0x00, 0x00, 0x00, 0x00, 0x00, 0x00, 0x00, 0x00, 0x00,
  0x00, 0x00, 0x00, 0x00, 0x00, 0x00, 0x00, 0x00, 0x00, 0x00, 0x00, 0x00, 0x00, 0x00, 0x00, 0x00,
  0x00, 0x00, 0x00, 0x00, 0x00, 0x00, 0x00, 0x00, 0x00, 0x00, 0x00, 0x00, 0x00, 0x00, 0x00, 0x00,
  //Address: 0x0200 (Page 2)
  0x80, 0x40, 0x20, 0x10, 0x08, 0x04, 0x02, 0x01, 0xD3, 0x97, 0xF6, 0x3B, 0x0F, 0x18, 0x19, 0xF6,
  0x3B, 0x15, 0x18, 0x19, 0x1A, 0xF6, 0x3B, 0x1B, 0x19, 0x1A, 0x1B, 0xF6, 0x3B, 0x21, 0x1A, 0x1B,
  0x1C, 0xF6, 0x3B, 0x27, 0x1B, 0x1C, 0x1D, 0xF6, 0x3B, 0x2D, 0x1C, 0x1D, 0x1E, 0xF6, 0x3B, 0x33,
  0x1D, 0x1E, 0x1F, 0x32, 0x37, 0x1E, 0x1F, 0x86, 0xF6, 0x3B, 0x3C, 0x19, 0xF6, 0x3B, 0x41, 0x18,
  //Address: 0x0240
  0x1A, 0xF6, 0x3B, 0x46, 0x19, 0x1B, 0xF6, 0x3B, 0x4B, 0x1A, 0x1C, 0xF6, 0x3B, 0x50, 0x1B, 0x1D,
  0xF6, 0x3B, 0x55, 0x1C, 0x1E, 0xF6, 0x3B, 0x5A, 0x1D, 0x1F, 0x32, 0x5D, 0x1E, 0x28, 0x28, 0x29,
  0x29, 0x8A, 0xFF, 0x02, 0xAA, 0x8B, 0xFF, 0x02, 0xAB, 0x2C, 0x2C, 0x2D, 0x2D, 0x2E, 0x2E, 0x8F,
  0xFF, 0x02, 0xAF, 0x88, 0x32, 0x7D, 0xFF, 0x01, 0x32, 0x7F, 0xFE, 0x30, 0x7E, 0x86, 0xF6, 0x96,
  //Address: 0x0280
  0x76, 0xB6, 0x89, 0x32, 0x8C, 0xFF, 0x01, 0x32, 0x8F, 0xFE, 0x30, 0x8E, 0x86, 0xF6, 0xF6, 0x96,
  0x76, 0xB6, 0x8A, 0x32, 0x9C, 0xFF, 0x01, 0x32, 0xA0, 0xFE, 0x30, 0x9F, 0x86, 0xF6, 0xF6, 0xF6,
  0x96, 0x76, 0xB6, 0x8B, 0x32, 0xAD, 0xFF, 0x01, 0x32, 0xB2, 0xFE, 0x30, 0xB1, 0x86, 0xF6, 0xF6,
  0xF6, 0xF6, 0x96, 0x76, 0xB6, 0x8C, 0x32, 0xBF, 0xFF, 0x01, 0x32, 0xC4, 0xF6, 0x30, 0xC3, 0x86,
  //Address: 0x02C0
  0xFE, 0xFE, 0xFE, 0xFE, 0x96, 0x76, 0xB6, 0x8D, 0x32, 0xD1, 0xFF, 0x01, 0x32, 0xD5, 0xF6, 0x30,
  0xD4, 0x86, 0xFE, 0xFE, 0xFE, 0x96, 0x76, 0xB6, 0x8E, 0x32, 0xE2, 0xFF, 0x01, 0x32, 0xE5, 0xF6,
  0x30, 0xE4, 0x86, 0xFE, 0xFE, 0x96, 0x76, 0xB6, 0x8F, 0x32, 0xF2, 0xFF, 0x01, 0x32, 0xF4, 0xF6,
  0x30, 0xF3, 0x86, 0xFE, 0x96, 0x76, 0x55, 0x30, 0x08, 0x00, 0x00, 0x00, 0x00, 0x00, 0x00, 0x00
};


//Program 7 - Serial Echo Test Program (Q follows EF3)
//  Run this short program and any Serial text input received by /EF3 will be echoed out on Q
const uint8_t echo_test[] PROGMEM = {
  0x7B, 0x36, 0x00, 0x7A, 0x30, 0x01
};

// Program 8 - IDIOT Monitor
// Written by Lee Hart
//
//      TMSI IDIOT/4 Monitor Summary
//
//The monitor expects 7 bit serial MARK parity at 1200 baud or slower. Start
//the monitor at the lowest address of code; it will "look" for a "CR" character
//from your terminal to establish baud rate; then send "IDIOT" and the ? prompt.
//
//All inputs are echoed but ignored until one of the following commands is
//typed. All numbers are in hexadecimal. Follow each command with a <CR>.
//Backspace, Rubout, etc. aren't used. Spaces, Linefeeds, etc. can be used
//freely except if they cause ambiguity. Only the last 4 digits of byte
//counts and addresses are used; continue typing to correct errors.
//
//?Maaaa nnnn <CR>  Examine Memory: Lists nnnn bytes of memory
//      starting at address aaaa. Each line begins with
//      the address, followed by up to 16 data bytes in
//      groups of 2. If more, the line ends with a
//      semicolon (;) and the listing continues on the
//      next line.
//
//!Maaaa dd..dd; comment  Change Memory: Writes data byte pairs dd into
//  aaaa dd..dd, comment  successive locations beginning at address aaaa.
//       dd..dd <CR>  End the line with a semicolon (;) to continue
//      on the next line at a new address. End the line
//      with a comma (,) to continue on next line at the
//      next consecutive address. Comments after the ";"
//      or "," are ignored. Accepts ?M format.
//
//?Maaaa nnnn !Mbbbb <CR> Move Memory: Moves a block of nnnn bytes of
//      memory from address aaaa to bbbb. Blocks can
//      be any size and can overlap without error.
//
//?R      Examine Registers: Lists 1802 registers as they
//      were saved in RAM at the time of entering the
//      monitor. Format is same as $M. Contents can be
//      altered using !M to change the memory image,
//      then $R to restore them. Example:
//  ?R <CR)
//  10B8 (ID,T) (DF,D) (IE,Q) (EF1-4)
//  10C0 (R0) (R1) (R2) (R3) (R4) (R5) (R6) (R7);
//  10D0 (R8) (R9) (RA) (RB) (RC) (RD) (RE) (RF)
//  *
//
//$R <CR>     Run Registers: Restore 1802 registers to the
//$Rp <CR>    values shown by the ?R command, and begin
//$Rxp <CR>   execution with the specified values of X and P
//      (or 0 if not specified). Example: If entered
//      from BASIC, return with "$R23".
//
//$Paaaa <CR>             Run Program: Begin program execution at address
//      aaaa with X=0, P=0, and interrupts disabled.
//      "$P0" is the same as a hardware reset.
//
//Hardware Interrupt: If interrupts are enabled, a hardware interrupt
//enters the monitor and T contains the old X and P. Return with $R(T).
//
//Breakpoints (for programs in RAM): Replace 1 byte of program with SEP R1
//(D1) using !M. When executed, D1 saves all registers in RAM except P and
//X, and enters the monitor. To also save X and P, replace 2 bytes of
//program with MARK, SEP R1 (79, D1). MARK saves X and P in T and M(R2),
//and decrements R2.
//
//To resume after a breakpoint, restore the original bytes replaced in the
//program, adjust the program counter accordingly, and return with $Rxp.
//
// IDIOT -2
const uint8_t idiot_monitor[] PROGMEM = {
  //Address: 0x0000 (Page 0)
  //00    1     2     3     4     5     6     7     8     9     A     B     C     D     E     F
  0x71, 0x00, 0xF8, 0xFF, 0xB4, 0xF8, 0xFF, 0xA4, 0x54, 0x04, 0xFB, 0xFF, 0xC6, 0x54, 0x04, 0x32,
  0x1A, 0x94, 0x32, 0xDD, 0xA4, 0x24, 0x84, 0xB4, 0x30, 0x05, 0xF8, 0xDF, 0xA4, 0xE4, 0x8F, 0x73,
  0x9F, 0x73, 0x8E, 0x73, 0x9E, 0x73, 0x8D, 0x73, 0x9D, 0x73, 0x8C, 0x73, 0x9C, 0x73, 0x8B, 0x73,
  0x9B, 0x73, 0x8A, 0x73, 0x9A, 0x73, 0x89, 0x73, 0x99, 0x73, 0x88, 0x73, 0x98, 0x73, 0x87, 0x73,
  //Address: 0x0040 (Page 0)
  //00    1     2     3     4     5     6     7     8     9     A     B     C     D     E     F  
  0x97, 0x73, 0x86, 0x73, 0x96, 0x73, 0x85, 0x73, 0x95, 0x73, 0x73, 0x73, 0x83, 0x73, 0x93, 0x73,
  0x82, 0x73, 0x92, 0x73, 0x81, 0x73, 0x91, 0x73, 0x80, 0x73, 0x90, 0x73, 0xF8, 0x00, 0xB3, 0x3F,
  0x63, 0xF9, 0x04, 0x3E, 0x67, 0xF9, 0x30, 0x73, 0x93, 0x3D, 0x6D, 0xF9, 0x02, 0x3C, 0x71, 0xF9,
  0x10, 0x73, 0x93, 0xC5, 0xF9, 0x01, 0x73, 0xF8, 0x01, 0xCC, 0xF8, 0x00, 0x73, 0x93, 0x73, 0x7C,
  //Address: 0x0080 (Page 0)
  //00    1     2     3     4     5     6     7     8     9     A     B     C     D     E     F  
  0x00, 0x73, 0x78, 0x24, 0xF8, 0xC5, 0xA1, 0x90, 0xB1, 0xF8, 0x8D, 0xA1, 0xD1, 0xF8, 0x00, 0x54,
  0xF8, 0xCA, 0xA5, 0x91, 0xFC, 0x03, 0xB5, 0xF8, 0xA0, 0xA4, 0xF8, 0x18, 0xA3, 0x45, 0x54, 0x14,
  0x23, 0x83, 0x3A, 0x9D, 0x94, 0xB2, 0xF8, 0xC3, 0xA4, 0xF8, 0xBB, 0x73, 0x91, 0x73, 0x91, 0xFC,
  0x01, 0xB5, 0xF8, 0xF8, 0xA5, 0xF8, 0xFE, 0xA3, 0x91, 0xB3, 0xD3, 0xE2, 0x22, 0x73, 0x94, 0x73,
  //Address: 0x00C0 (Page 0)
  //00    1     2     3     4     5     6     7     8     9     A     B     C     D     E     F  
  0x84, 0x52, 0xE4, 0x30, 0x02, 0xF8, 0x10, 0x73, 0xF8, 0xC9, 0xA4, 0x42, 0x73, 0x42, 0x73, 0xF8,
  0xBB, 0xA4, 0x42, 0x54, 0xF8, 0xC5, 0xA4, 0x82, 0x73, 0x92, 0x73, 0x30, 0x90, 0x90, 0xFC, 0x01,
  0xB3, 0xF8, 0xF8, 0xA3, 0xE2, 0xD3, 0x00, 0x00, 0x00, 0x00, 0x00, 0x00, 0x00, 0x00, 0xD3, 0x9E,
  0xF6, 0xAE, 0x2E, 0x43, 0xFF, 0x01, 0x3A, 0xF4, 0x8E, 0x32, 0xEE, 0x23, 0x30, 0xF2, 0x93, 0xBC,
  //Address: 0x0100 (Page 1)
  //00    1     2     3     4     5     6     7     8     9     A     B     C     D     E     F  
  0xF8, 0xEF, 0xAC, 0xF8, 0x00, 0xAE, 0xAF, 0x36, 0x07, 0x3E, 0x09, 0xF8, 0x03, 0xFF, 0x01, 0x3A,
  0x0D, 0x8F, 0x3A, 0x17, 0x36, 0x19, 0x1F, 0x36, 0x1E, 0x1E, 0xF8, 0x07, 0x30, 0x0D, 0x2E, 0x2E,
  0x8E, 0xF9, 0x01, 0xBE, 0xDC, 0x0C, 0x3E, 0x2C, 0x9E, 0xFA, 0xFE, 0xBE, 0xDC, 0x26, 0xD5, 0xFC,
  0x07, 0x33, 0x37, 0xFC, 0x0A, 0x33, 0x88, 0xFC, 0x00, 0x9F, 0xD5, 0xF8, 0x80, 0x38, 0x83, 0xC8, 
  //Address: 0x0140 (Page 1)
  //00    1     2     3     4     5     6     7     8     9     A     B     C     D     E     F  
  0xF8, 0x00, 0xAF, 0xF8, 0x80, 0xBF, 0xE3, 0x8F, 0xC6, 0x67, 0x80, 0x3E, 0x4B, 0x36, 0x4D, 0xDC,
  0x02, 0x36, 0x4D, 0x8F, 0xC6, 0x67, 0x40, 0xE2, 0xE2, 0x9E, 0xF6, 0x33, 0x62, 0x36, 0x61, 0x7A,
  0xC8, 0x7B, 0xC4, 0xC7, 0xE2, 0xE2, 0xE2, 0xC4, 0xC4, 0xDC, 0x07, 0x1E, 0x9F, 0xF6, 0xBF, 0x33,
  0x78, 0xF9, 0x80, 0x3E, 0x57, 0xBF, 0x30, 0x59, 0x7B, 0x32, 0x43, 0x8F, 0xFE, 0x3B, 0x39, 0x9F, 
   
 //Address: 0x0180 (Page 1)
  //00    1     2     3     4     5     6     7     8     9     A     B     C     D     E     F  
  0xFF, 0x41, 0x3B, 0x2F, 0xFF, 0x06, 0x33, 0x37, 0xFE, 0xFE, 0xFE, 0xFE, 0xFC, 0x08, 0xFE, 0xAE,
  0x8D, 0x7E, 0xAD, 0x9D, 0x7E, 0xBD, 0x8E, 0xFE, 0x3A, 0x8F, 0x30, 0x39, 0x9E, 0xAE, 0x38, 0xD5,
  0x45, 0x38, 0x46, 0x38, 0x9F, 0xAD, 0xFB, 0x0A, 0x3A, 0xBE, 0xF8, 0x5B, 0x30, 0xC0, 0x9F, 0xF6,
  0xF6, 0xF6, 0xF6, 0xFC, 0xF6, 0xC7, 0xFC, 0x07, 0xFF, 0xC6, 0xAD, 0xF8, 0x1B, 0xC8, 0xF8, 0x0B,  
  
  //Address: 0x01C0 (Page 1)
  //00    1     2     3     4     5     6     7     8     9     A     B     C     D     E     F  
  0xAF, 0x8E, 0xCE, 0xDC, 0x17, 0x7A, 0xDC, 0x07, 0xC4, 0xC4, 0xC4, 0xC4, 0xC4, 0xC4, 0x2F, 0xF5,
  0x8D, 0x76, 0xAD, 0xCF, 0x7A, 0xC8, 0x7B, 0xC4, 0x8F, 0xFA, 0x0F, 0x3A, 0xC6, 0x8F, 0xFC, 0xFB,
  0xAF, 0x3B, 0x9F, 0xFF, 0x1B, 0x32, 0x9F, 0xF8, 0x00, 0x33, 0xF5, 0x9F, 0xFA, 0x0F, 0xFC, 0xF6,
  0xC7, 0xFC, 0x07, 0xFF, 0xC6, 0xAD, 0x30, 0xC1, 0x95, 0xB3, 0xF8, 0x9C, 0xA3, 0xD3, 0x0D, 0xD3,
  
  //Address: 0x0200 (Page 2)
  //00    1     2     3     4     5     6     7     8     9     A     B     C     D     E     F    
  0x0A, 0xD3, 0x49, 0xD3, 0x44, 0xD3, 0x49, 0xD3, 0x4F, 0xD3, 0x54, 0xD3, 0x2D, 0xD3, 0x32, 0x95,
  0xFF, 0x01, 0xB3, 0xF8, 0x9C, 0xA3, 0xD3, 0x0D, 0xD3, 0x0A, 0xD3, 0x2A, 0xF8, 0x00, 0xBD, 0xAD,
  0xF8, 0x3B, 0xA3, 0xD3, 0xFB, 0x24, 0x32, 0xCC, 0xFB, 0x05, 0xA8, 0xCE, 0xFB, 0x1E, 0x3A, 0x1C,
  0xD3, 0xFB, 0x52, 0x3A, 0x40, 0xF8, 0xB8, 0xAA, 0x92, 0xBA, 0xF8, 0x28, 0xAD, 0xD3, 0x30, 0x5C, 
  
  //Address: 0x0240 (Page 2)
  //00    1     2     3     4     5     6     7     8     9     A     B     C     D     E     F    
  0xFB, 0x1F, 0x3A, 0x1C, 0xD3, 0x3B, 0x44, 0xD3, 0x33, 0x47, 0xFB, 0x20, 0x3A, 0xC1, 0x9D, 0xBA,
  0x8D, 0xAA, 0x88, 0x32, 0xAB, 0xF8, 0x00, 0xAD, 0xBD, 0xD3, 0x33, 0x59, 0x8D, 0xA8, 0x9D, 0xB8,
  0x9F, 0xFB, 0x21, 0x32, 0xFA, 0xFB, 0x01, 0x3A, 0x6C, 0xD3, 0x30, 0x61, 0xFB, 0x2D, 0x3A, 0xC1,
  0xF8, 0x9C, 0xA3, 0xD3, 0x0A, 0x3E, 0xC1, 0x9A, 0xBF, 0xF8, 0xAE, 0xA3, 0xD3, 0x8A, 0xBF, 0xF8,
    
  //Address: 0x0280 (Page 2)
  //00    1     2     3     4     5     6     7     8     9     A     B     C     D     E     F    
  0xAE, 0xA3, 0xD3, 0xD3, 0x20, 0x4A, 0xBF, 0xF8, 0xAE, 0xA3, 0xD3, 0x28, 0x88, 0x3A, 0x92, 0x98,
  0x32, 0x0F, 0x8A, 0xFA, 0x0F, 0x3A, 0x9D, 0xD3, 0x3B, 0xD3, 0x0D, 0x30, 0x73, 0xF6, 0x33, 0x85,
  0x30, 0x83, 0xD3, 0x3B, 0xA2, 0xD3, 0x3B, 0xC1, 0x8D, 0x5A, 0x1A, 0xD3, 0x33, 0xA5, 0xFB, 0x0D,
  0x32, 0x0F, 0xFB, 0x21, 0x32, 0xA2, 0xFB, 0x17, 0x3A, 0xAB, 0xD3, 0xFB, 0x0D, 0x3A, 0xBA, 0x30, 
    
  //Address: 0x02C0 (Page 2)
  //00    1     2     3     4     5     6     7     8     9     A     B     C     D     E     F      
  0x44, 0xF8, 0x9C, 0xA3, 0xD3, 0x0D, 0xD3, 0x0A, 0xD3, 0x3F, 0x30, 0x0F, 0xD3, 0xFB, 0x52, 0xA8,
  0xCE, 0xFB, 0x02, 0x3A, 0x1C, 0xD3, 0x33, 0xD5, 0xFB, 0x0D, 0x3A, 0xC1, 0x9D, 0xB0, 0x8D, 0xA0,
  0xF8, 0x9C, 0xA3, 0xD3, 0x0A, 0x88, 0x32, 0xFE, 0xF8, 0xBB, 0xA1, 0x95, 0xFF, 0x02, 0xB1, 0xE5,
  0x70, 0x00, 0x30, 0xFF, 0x30, 0xC1, 0xC4, 0xC4, 0x30, 0x0F, 0x95, 0xFC, 0x01, 0xB5, 0x92, 0xB3,  
  
  //Address: 0x0300 (Page 3)
  //00    1     2     3     4     5     6     7     8     9     A     B     C     D     E     F    
  0xF8, 0xBF, 0xA2, 0xE2, 0xF8, 0xC1, 0x52, 0x80, 0xAD, 0xFA, 0x0F, 0xFE, 0xF4, 0xA3, 0x03, 0x73,
  0xF8, 0xA8, 0x53, 0x23, 0x03, 0x73, 0x92, 0x53, 0xF0, 0xCE, 0x7B, 0x38, 0x7A, 0xF8, 0xC0, 0x73,
  0xF0, 0xBD, 0x22, 0x72, 0x73, 0xF8, 0xF8, 0x73, 0xF0, 0xF6, 0xF8, 0xA2, 0x73, 0xF8, 0xC5, 0xA3,
  0x03, 0x73, 0xF8, 0xF8, 0x73, 0xF8, 0xC0, 0xA2, 0xF0, 0xB0, 0x9D, 0x52, 0x12, 0xF0, 0xA0, 0x8D,   
  
  //Address: 0x0340 (Page 3)
  //00    1     2     3     4     5     6     7     8     9     A     B     C     D     E     F      
  0x52, 0x12, 0x72, 0xB1, 0x72, 0xA1, 0x60, 0x60, 0x72, 0xB3, 0x72, 0xA3, 0x72, 0xB4, 0x72, 0xA4,
  0x60, 0x60, 0x72, 0xB6, 0x72, 0xA6, 0x72, 0xB7, 0x72, 0xA7, 0x72, 0xB8, 0x72, 0xA8, 0x72, 0xB9,
  0x72, 0xA9, 0x72, 0xBA, 0x72, 0xAA, 0x72, 0xBB, 0x72, 0xAB, 0x72, 0xBC, 0x72, 0xAC, 0x72, 0xBD,
  0x72, 0xAD, 0x72, 0xBE, 0x72, 0xAE, 0x72, 0xBF, 0xF0, 0xAF, 0x30, 0x9E, 0xD3, 0xFB, 0x4D, 0x3A,  
  
  //Address: 0x0380 (Page 3)
  //00    1     2     3     4     5     6     7     8     9     A     B     C     D     E     F      
  0x86, 0xBD, 0xAD, 0xD3, 0x33, 0x83, 0xFB, 0x0D, 0x3A, 0xF0, 0x9A, 0xB3, 0x8A, 0xA3, 0x9D, 0xBF,
  0x8D, 0xAF, 0x93, 0x3A, 0x96, 0x83, 0x32, 0xAF, 0x23, 0x9F, 0x3A, 0x9D, 0x8F, 0xC8, 0x92, 0xB5,
  0x2F, 0x3A, 0x92, 0x98, 0x3A, 0xA7, 0x88, 0x32, 0xF4, 0x4A, 0x5D, 0x1D, 0x28, 0x30, 0xA3, 0x98,
  0xB3, 0x88, 0xA3, 0xC8, 0x1A, 0x1D, 0x23, 0x93, 0x3A, 0xB4, 0x83, 0x3A, 0xB4, 0xED, 0x98, 0x3A,
    
  //Address: 0x03C0 (Page 3)
  //00    1     2     3     4     5     6     7     8     9     A     B     C     D     E     F      
  0xC2, 0x88, 0x32, 0xF4, 0x0A, 0x73, 0x2A, 0x28, 0x30, 0xBE, 0xF8, 0xC0, 0xA2, 0x72, 0xCE, 0x70,
  0x38, 0x71, 0x15, 0xC8, 0x30, 0xB3, 0xF8, 0xCA, 0xA2, 0x42, 0xB5, 0x02, 0xA5, 0xF8, 0xC4, 0xA2,
  0x02, 0xB2, 0x00, 0x00, 0x00, 0x00, 0x00, 0x00, 0x00, 0x00, 0x00, 0x00, 0x00, 0x00, 0x00, 0x00,
  0x95, 0xFF, 0x01, 0xB5, 0x95, 0xFF, 0x01, 0xB5, 0x00, 0x00, 0x00, 0x00, 0x00, 0x00, 0x30, 0x7C
  };

//Get Character for a Hex value for a nibble (0-F)
char getNibbleChar(byte h_value) {
  char c_hex = '0';
  
  if (h_value < 10) {
    //Nibbles 0 - 9
    c_hex = '0' + h_value;  
  } else {
    //Nibbles A - F
    c_hex = 'A' + (h_value - 10);  
  }
  return c_hex;
} //getNibbleChar

//Get the charcter for a Hex Digit in a byte value 
// data - byte value (0x00 to 0xFF)
// digit - 0 for High Nibble, 1 for Low Nibble
char getHexDigitChar(byte data, byte digit) {
  char c_nibble = '0';
  
  if (digit == 0) {
    c_nibble = getNibbleChar((data & 0xF0) >> 4);
  } else {
    c_nibble = getNibbleChar(data & 0x0F);
  } //if digit == 0

  return c_nibble;
} //getHexDigitChar

//Get the next character from a hexidecimal program byte
char getNextByteChar(byte program_type, int offset, byte nibble) {
  char c_byte = 'F'; //Default to all F's
  int  pgm_size = 0;
  byte pgm_data = 0;

  //Check variables for valid range
  if (nibble < 2 && offset < pgm_page_size) {
    switch (program_type) {
      //Load all zeros
      case PGM_ZEROS:
        c_byte = '0';
      break;
      //Load a sequence of digits in the page
      case PGM_SEQUENCE:
        //As the offset goes from 0 to 0xFF get the hex character for each nibble
        c_byte = getHexDigitChar(offset, nibble);
      break;

      //Load the classic spaceship program in the page
      case PGM_SPACESHIP:              
        pgm_data = pgm_read_byte_near(spaceship + offset);
        c_byte = getHexDigitChar(pgm_data, nibble);
      break;

      case PGM_TV_CLOCK:
        if (offset < sizeof(tv_digital_clock)) {              
          pgm_data = pgm_read_byte_near(tv_digital_clock + offset);
          c_byte = getHexDigitChar(pgm_data, nibble);
        } else {
          //Pad with zeros until the end of page
          c_byte = '0';
        } //if-else offset < sizeof tv_digital_clock
      break;
      
      case PGM_VIDEO_TEST:
        if (offset < sizeof(video_dma_test)) {              
          pgm_data = pgm_read_byte_near(video_dma_test + offset);
          c_byte = getHexDigitChar(pgm_data, nibble);
        } else {
          //Pad with zeros until the end of page
          c_byte = '0';
        } //if-else offset < sizeof tv_digital_clock
      break;

      case PGM_MONITOR:
        if (offset < sizeof(eetops_monitor)) {              
          pgm_data = pgm_read_byte_near(eetops_monitor + offset);
          c_byte = getHexDigitChar(pgm_data, nibble);
        } else {
          //Pad with zeros until the end of page
          c_byte = '0';
        } //if-else offset < sizeof eetops_monitor
      break;      

      case PGM_LIFE:
        if (offset < sizeof(game_of_life)) {              
          pgm_data = pgm_read_byte_near(game_of_life + offset);
          c_byte = getHexDigitChar(pgm_data, nibble);
        } else {
          //Pad with zeros until the end of page
          c_byte = '0';
        } //if-else offset < sizeof game_of_life
      break; 
      
      case PGM_ECHO:
        if (offset < sizeof(echo_test)) {              
          pgm_data = pgm_read_byte_near(echo_test + offset);
          c_byte = getHexDigitChar(pgm_data, nibble);
        } else {
          //Pad with zeros until the end of page
          c_byte = '0';
        } //if-else offset < sizeof echo_test
      break; 
             
          
      case PGM_IDIOT:
        if (offset < sizeof(idiot_monitor)) {              
          pgm_data = pgm_read_byte_near(idiot_monitor + offset);
          c_byte = getHexDigitChar(pgm_data, nibble);
        } //if-else offset < sizeof idiot_monitor
      break;  
                    
      //Send all F's for any undefined case
      default:
        //Do nothing
      break;        
    } // switch
  } // if nibble < 2 && offset < pgm_page_size
#if DEBUG
  Serial.print(c_byte);
#endif
  return c_byte;
} //getNextByteChar
